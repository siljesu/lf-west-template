// / { 
//	aliases {
//		led1 = &red_led;
//	};
//	red_led : led-1 {
//		compatible = "gpio-leds";
//		gpios = < &gpio9 0x19 0x0 >;
//		label = "User LED D34";
//		status = "okay";
//	};
//};
&enet {
	zephyr,random-mac-address; 
	status = "okay";
};
