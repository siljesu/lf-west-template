
&{/leds} {
	compatible = "gpio-leds";
	led-2 {
		gpios = < &gpio9 0x19 GPIO_ACTIVE_HIGH >;
		label = "User LED D34";
		status = "okay";
	};
};
//0x19 ar D34
&enet {
	local-mac-address = [00 0a 35 00 00 02];
	status = "okay";
};
